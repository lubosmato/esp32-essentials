## Kconfig.projbuild
```kconfig
menu "MQTT Configuration"
  config WIFI_AP_SSID
    string "Emergency wifi AP SSID"
    default "esp32"
    help
      If esp32 can't connect to a wifi network when booting esp32 starts emergency wifi AP 
      so the user can connect and setup the device in settings web. 
  
  config WIFI_AP_PASS
    string "Emergency wifi AP password"
    default "12345678"

  config WIFI_AP_DEFAULT_CHANNEL
    int "Emergency wifi AP channel"
    default 6

endmenu
```
